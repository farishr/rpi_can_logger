VERSION ""

NS_ :

BS_:

BU_:

BO_ 128 TEST_MSG: 8 Vector__XXX
 SG_ Mux M : 0|4@1+ (1,0) [0|0] "" Vector__XXX
 SG_ ResponseID : 4|4@1+ (1,0) [0|0] "" Vector__XXX
 SG_ TestValA m0 : 8|32@1+ (1,0) [0|0] "" Vector__XXX
 SG_ TestValB m0 : 48|16@1+ (1,0) [0|0] "" Vector__XXX
